#include <Arduino.h>

#include "LED.h"       // Includes the header file for controlling the LED matrix

int ledMatrix[32][32] = {
  {0, 0, 0, 0, 0, 0, 0, 0, 0, 0, 0, 0, 0, 0, 0, 0, 0, 0, 0, 0, 0, 0, 0, 0, 0, 0, 0, 0, 0, 0, 0, 0},
  {0, 0, 0, 0, 0, 0, 0, 0, 0, 0, 0, 0, 0, 0, 0, 0, 0, 0, 0, 0, 0, 0, 0, 0, 0, 0, 0, 0, 0, 0, 0, 0},
  {0, 0, 0, 0, 0, 0, 0, 0, 0, 0, 0, 0, 0, 0, 0, 0, 0, 0, 0, 0, 0, 0, 0, 0, 0, 0, 0, 0, 0, 0, 0, 0},
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  {0, 0, 0, 0, 0, 0, 0, 0, 0, 0, 0, 0, 0, 0, 0, 0, 0, 0, 0, 0, 0, 0, 0, 0, 0, 0, 0, 0, 0, 0, 0, 0}
};

int alphabet[5][111] = {
  {0, 1, 0, 0, 1, 1, 0, 0, 0, 1, 0, 0, 1,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 1, 1}, //abcdefgh
  {1, 0, 1, 0, 1, 0, 1, 0, 1, 0, 1, 0, 1,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 0, 1},
  {1, 1, 1, 0, 1, 1, 0, 0, 1, 0, 0, 0, 1,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 1, 0},
  {1, 0, 1, 0, 1, 0, 1, 0, 1, 0, 1, 0, 1,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 0, 0},
  {1, 0, 1, 0, 1, 1, 0, 0, 0, 1, 0, 0, 1,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 1, 1},
};

int numbers[5][39] = {
  {1, 1, 1, 0, 0, 1, 0, 0, 1, 1, 1, 0, 1, 1, 1, 0, 1, 0, 1, 0, 1, 1, 1, 0, 1, 1, 1, 0, 1, 1, 1, 0, 1, 1, 1, 0, 1, 1, 1},
  {1, 0, 1, 0, 1, 1, 0, 0, 0, 0, 1, 0, 0, 0, 1, 0, 1, 0, 1, 0, 1, 0, 0, 0, 1, 0, 0, 0, 0, 0, 1, 0, 1, 0, 1, 0, 1, 0, 1},
  {1, 0, 1, 0, 0, 1, 0, 0, 1, 1, 1, 0, 0, 1, 1, 0, 1, 1, 1, 0, 1, 1, 1, 0, 1, 1, 1, 0, 0, 1, 0, 0, 1, 1, 1, 0, 1, 1, 1},
  {1, 0, 1, 0, 0, 1, 0, 0, 1, 0, 0, 0, 0, 0, 1, 0, 0, 0, 1, 0, 0, 0, 1, 0, 1, 0, 1, 0, 0, 1, 0, 0, 1, 0, 1, 0, 0, 0, 1},
  {1, 1, 1, 0, 1, 1, 1, 0, 1, 1, 1, 0, 1, 1, 1, 0, 0, 0, 1, 0, 1, 1, 1, 0, 1, 1, 1, 0, 0, 1, 0, 0, 1, 1, 1, 0, 0, 0, 1}
};

// space . 
int chars[5][39] = {
  {0, 0, 0, 0, 0, 0, 0, 0, 0, 0, 0, 0, 0, 0, 0},
  {0, 0, 0, 0, 0, 0, 0, 0, 0, 0, 0, 0, 0, 1, 0},
  {0, 0, 0, 0, 0, 0, 0, 0, 0, 0, 0, 0, 0, 0, 0},
  {0, 0, 0, 0, 0, 0, 0, 0, 0, 1, 0, 0, 0, 1, 0},
  {0, 0, 0, 0, 0, 1, 0, 0, 1, 1, 0, 0, 1, 1, 0}
};

void drawAlphabet() {
  // Iterate through the matrix
  for (int x = 1; x < 33; x++) {
    for (int y = 1; y < 32; y++) {
      // Draw the pixel if the matrix value is 1
      if (alphabet[y - 1][x - 1] == 1) {
        pixel(x, 33 - y, "#ffffff"); // Adjusts position to center
      }
    }
  }
}

void drawNumber() {
  // Iterate through the matrix
  for (int x = 1; x < 33; x++) {
    for (int y = 1; y < 32; y++) {
      // Draw the pixel if the matrix value is 1
      if (numbers[y - 1][x - 1] == 1) {
        pixel(x, 33 - y, "#ffffff"); // Adjusts position to center
      }
    }
  }
}

void drawMatrix() {
  // Iterate through the matrix
  for (int x = 1; x < 32; x++) {
    for (int y = 1; y < 32; y++) {
      // Draw the pixel if the matrix value is 1
      if (ledMatrix[y - 1][x - 1] == 1) {
        pixel(x, y, "#ffffff"); // Adjusts position to center
      }
    }
  }
}

String pickColor() {
  String letters[16] = {"a", "b", "c", "d", "e", "f", "1", "2", "3", "4", "5", "6", "7", "8", "9", "0"};
  String randString = "";
  for (int i = 1; i <= 6; i++) {
    randString += letters[random(0, 15)];
  }
  return "#" + randString;
}

void drawLetter(char letter, int startX, int startY, String color) {
  int x_ = (letter - 'a') * 4;
  for (int x = 1; x <= 3; x++) {
    for (int y = 1; y <= 5; y++) {
      if (alphabet[y - 1][x - 1 + x_] == 1) {
        pixel(x + startX, 33 - y - startY, color);
      }
    }
  }
}

void drawNumbers(int number, int startX, int startY, String color) {
  int x_ = number * 4;
  for (int x = 1; x <= 3; x++) {
    for (int y = 1; y <= 5; y++) {
      if (numbers[y - 1][x - 1 + x_] == 1) {
        pixel(x + startX, 33 - y - startY, color);
      }
    }
  }
}

void drawPoint(char char_, int startX, int startY, String color) {

  int pos = 0;
  if (char_==' ') {
    pos = 0;
  } else if (char_=='.') {
    pos = 1;
  }

  int xOffset = pos * 4;  // Ajusta a posição da letra com base no índice fornecido
  for (int x = 1; x <= 3; x++) {
    for (int y = 1; y <= 5; y++) {
      if (chars[y - 1][x - 1 + xOffset] == 1) {
        pixel(x + startX, 33 - y - startY, color);
      }
    }
  }
}

void write(const char* word, int y) {
  int x = 0; // Initial position on the X axis

  //String color = pickColor();
  String color = "#FFFFFF";

  // Iterate through each character of the word
  for (int i = 0; word[i] != '\0'; i++) {
    char c = word[i];
    if (c >= 'a' && c <= 'z') { // If it's a lowercase letter
      drawLetter(c, x, y, color);
    } else if (c >= '0' && c <= '9') { // If it's a number //TODO: isso ta errado kkkk (mas porque ta desenhando? kkkkk), tinha que converter pra int
      drawNumbers(c - '0', x, y, color); // Convert the numeric character to an integer
    } else if (c == '.') { // If it's a number
      drawPoint(c, x, y, color);
    } else if (c == ' ') { // If it's a number
      x -= 2; // Define the space for unknown characters
    } else {
      x += 4; // Define the space for unknown characters
    }
    x += 4; // Increment the X position for the next character
  }
}

